

// libs
#include <Arduino.h>
#include <Wire.h>
#include <Adafruit_GFX.h>
#include <Adafruit_SSD1306.h>
#include <Adafruit_BMP280.h>
#include <vector>

// images
// '1-healthy-invert', 50x50px
const unsigned char epd_bitmap_1_healthy_invert [] PROGMEM = {
	0x00, 0x00, 0x00, 0x00, 0x00, 0x00, 0x00, 0x00, 0x00, 0x00, 0x00, 0x00, 0x00, 0x00, 0x00, 0x00, 
	0x00, 0x00, 0x00, 0x00, 0x00, 0x00, 0x00, 0x3f, 0xfc, 0x00, 0x00, 0x00, 0x00, 0x01, 0xff, 0xff, 
	0x80, 0x00, 0x00, 0x00, 0x03, 0xe0, 0x0f, 0xc0, 0x00, 0x00, 0x00, 0x07, 0x80, 0x00, 0xe0, 0x00, 
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	0x00, 0x00, 0x00, 0x00, 0x00, 0x00, 0x00, 0x00, 0x00, 0x00, 0x00, 0x00, 0x00, 0x00
};
// '2-kinda-invert', 50x50px
const unsigned char epd_bitmap_2_kinda_invert [] PROGMEM = {
	0x00, 0x00, 0x00, 0x00, 0x00, 0x00, 0x00, 0x00, 0x00, 0x00, 0x00, 0x00, 0x00, 0x00, 0x00, 0x00, 
	0x00, 0x00, 0x00, 0x00, 0x00, 0x00, 0x00, 0x3f, 0xf8, 0x00, 0x00, 0x00, 0x00, 0x01, 0xff, 0xff, 
	0x80, 0x00, 0x00, 0x00, 0x03, 0xe0, 0x1f, 0xc0, 0x00, 0x00, 0x00, 0x0f, 0x80, 0x01, 0xe0, 0x00, 
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	0x00, 0x00, 0x00, 0x00, 0x00, 0x00, 0x00, 0x00, 0x00, 0x00, 0x00, 0x00, 0x00, 0x00
};
// '3-nothealthy-inver', 50x50px
const unsigned char epd_bitmap_3_nothealthy_inver [] PROGMEM = {
	0x00, 0x00, 0x00, 0x00, 0x00, 0x00, 0x00, 0x00, 0x00, 0x00, 0x00, 0x00, 0x00, 0x00, 0x00, 0x00, 
	0x00, 0x00, 0x00, 0x00, 0x00, 0x00, 0x00, 0x3f, 0xf8, 0x00, 0x00, 0x00, 0x00, 0x01, 0xff, 0xff, 
	0x80, 0x00, 0x00, 0x00, 0x03, 0xe0, 0x1f, 0xc0, 0x00, 0x00, 0x00, 0x0f, 0x80, 0x01, 0xe0, 0x00, 
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	0x00, 0x00, 0x00, 0x00, 0x00, 0x00, 0x00, 0x00, 0x00, 0x00, 0x00, 0x00, 0x00, 0x00
};
// '4-dying-invert', 50x50px
const unsigned char epd_bitmap_4_dying_invert [] PROGMEM = {
	0x00, 0x00, 0x00, 0x00, 0x00, 0x00, 0x00, 0x00, 0x00, 0x00, 0x00, 0x00, 0x00, 0x00, 0x00, 0x00, 
	0x00, 0x00, 0x00, 0x00, 0x00, 0x00, 0x00, 0x1f, 0xf8, 0x00, 0x00, 0x00, 0x00, 0x00, 0x7f, 0xff, 
	0x00, 0x00, 0x00, 0x00, 0x01, 0xe0, 0x1f, 0x80, 0x00, 0x00, 0x00, 0x07, 0x80, 0x01, 0xc0, 0x00, 
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	0x00, 0x02, 0x00, 0x00, 0x00, 0x00, 0x00, 0x00, 0x00, 0x00, 0x00, 0x00, 0x00, 0x00
};
// '5-dead-invert', 50x50px
const unsigned char epd_bitmap_5_dead_invert [] PROGMEM = {
	0x00, 0x00, 0x00, 0x00, 0x00, 0x00, 0x00, 0x00, 0x00, 0x00, 0x00, 0x00, 0x00, 0x00, 0x00, 0x00, 
	0x00, 0x00, 0x00, 0x00, 0x00, 0x00, 0x00, 0x3f, 0xf8, 0x00, 0x00, 0x00, 0x00, 0x01, 0xff, 0xff, 
	0x00, 0x00, 0x00, 0x00, 0x03, 0xe0, 0x1f, 0xc0, 0x00, 0x00, 0x00, 0x07, 0x00, 0x01, 0xe0, 0x00, 
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	0x00, 0x00, 0x00, 0x00, 0x00, 0x00, 0x00, 0x00, 0x00, 0x00, 0x00, 0x00, 0x00, 0x00
};


// pin assignment
const int button1 = 17;
const int button2 = 4;
const int button3 = 2;
const int buzzer  = 16;

// buttons
const int buttons[] = {17, 4, 2};
const int numButtons = sizeof(buttons) / sizeof(buttons[0]);
int lastState[numButtons] = {HIGH, HIGH, HIGH};


// bmp
Adafruit_BMP280 bmp; // initalizing the object

// buzzer
const int pwmChannel = 0;
const int pwmResolution = 8; // 8-bit duty cycle
const int pwmFreq = 3000;

// oled
#define SCREEN_WIDTH 128
#define SCREEN_HEIGHT 64
#define OLED_RESET    -1
Adafruit_SSD1306 display(SCREEN_WIDTH, SCREEN_HEIGHT, &Wire, OLED_RESET); // initalizing the object

// images

// vars
bool buzzerActive = false;
std::vector<std::string> menuItems {
	"Canary",
	"Info"
};
int menuSelection = 0;
bool DEBUG = false;
bool canaryActive = false;

// temp ranges
struct TempRange {
	float min;
	float max;
	const unsigned char* image;
};

std::vector<TempRange> tempRanges = {
	{0.0, 18.0, epd_bitmap_4_dying_invert},        // too cold
	{18.0, 24.0, epd_bitmap_3_nothealthy_inver},  // cool
	{24.0, 28.0, epd_bitmap_1_healthy_invert},     // healthy
	{28.0, 32.0, epd_bitmap_2_kinda_invert},     // warm
	{32.0, 100.0, epd_bitmap_5_dead_invert}        // too hot
};

void setup() {
    // serial
    Serial.begin(115200);

    // pins
    pinMode(button1, INPUT_PULLUP);
    pinMode(button2, INPUT_PULLUP);
    pinMode(button3, INPUT_PULLUP);

    // buzzer
    ledcSetup(pwmChannel, pwmFreq, pwmResolution);
    ledcAttachPin(buzzer, pwmChannel);

    // i2c
    Wire.begin(21, 22);

    // oled
    if (!display.begin(SSD1306_SWITCHCAPVCC, 0x3C)) {
        Serial.println("cant find oled");
        for (;;);
    }

    // bmp280
    if (!bmp.begin(0x76)) {
        Serial.println("cant find bmp");
        for (;;);
    }

    // completion
    display.clearDisplay();

    display.setTextSize(2);
    display.setTextColor(SSD1306_WHITE);
    display.setCursor(0,0);
    display.println("Canary");

    display.setTextSize(1);
    display.setCursor(0, 25);
    display.println("> canary mode");
    display.setCursor(0, 35);
    display.println("  info");

    display.display();

    Serial.println("setup done");
}


void displayMenu() {

    display.clearDisplay();
    display.setTextSize(2);
    display.setTextColor(SSD1306_WHITE);
    display.setCursor(0,0);
    display.println("Canary");

    display.setTextSize(1);
    for (int i = 0; i < menuItems.size(); i++) {
    if (i == menuSelection) display.print("> "); else display.print("  ");

        display.println(menuItems[i].c_str()); // convert into c string

    }
    display.display();

}

void selectMenuItem() {
    if (menuItems[menuSelection] == "Canary") {
        canaryActive = true;
    } else if (menuItems[menuSelection] == "Info") {
        canaryActive = false;

        display.clearDisplay();
        display.setTextSize(1);
        display.setCursor(0,0);
        display.println("Canary ESP32 v1.0, Environmental health detector");
        display.display();
    }
}

void loop() {
    // read pins
    int b1 = digitalRead(button1);
    int b2 = digitalRead(button2);
    int b3 = digitalRead(button3);
    
    // read bmp280
    float temperature = bmp.readTemperature();
    float pressure = bmp.readPressure() / 100.0F;

    // debug prints
    if (DEBUG){
    Serial.printf("B1:%d B2:%d B3:%d | T=%.2fC P=%.2fhPa\n",
                b1, b2, b3, temperature, pressure);
    }

    for (int i = 0; i < numButtons; i++) {
        int reading = digitalRead(buttons[i]);
        // detect button press
        if (reading == LOW && lastState[i] == HIGH) {
            if (DEBUG){
                Serial.print("button: "); Serial.println(i+1);
            }

            if (i == 0) {
                menuSelection -= 1;
                if (menuSelection < 0) menuSelection = menuItems.size() - 1;
                canaryActive = false;
            }
            if (i == 2) {
                menuSelection += 1;
                if (menuSelection >= menuItems.size()) menuSelection = 0;
                canaryActive = false;
            }

            ledcWriteTone(pwmChannel, 3000);
            delay(100);
            ledcWriteTone(pwmChannel, 0);

            displayMenu();

            if (i == 1){
                selectMenuItem();
            }
        }
        lastState[i] = reading;
    }

    // real time
    if (canaryActive) {
        float temp = bmp.readTemperature();
        float press = bmp.readPressure() / 100.0;
        const unsigned char* imageToShow = epd_bitmap_1_healthy_invert; // default
        for (const auto& range : tempRanges) {
            if (temp >= range.min && temp < range.max) {
                imageToShow = range.image;
                break;
            }
        }

	display.clearDisplay();
	display.drawBitmap(0, 7, imageToShow, 50, 50, SSD1306_WHITE);
	display.setTextSize(1);
	display.setCursor(56, 18);
	display.print("Temp:");
	display.setCursor(56, 28);
	display.print(String(temp,1) + "C");
	display.setCursor(56, 42);
	display.print("Press:");
	display.setCursor(56, 52);
	display.print(String(press,1) + " hPa");
	display.display();

    }


    delay(100);
}